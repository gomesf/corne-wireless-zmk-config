## config/west.yml
```yaml
# Add mouse support (beta)
#https://gist.github.com/krissen/dd27082e7ab0575619c7a31f4d2ec7ae
manifest:
  remotes:
    - name: zmkfirmware
      #url-base: https://github.com/ftc/
      url-base: https://github.com/urob/
  projects:
    - name: zmk
      remote: zmkfirmware
      #revision: mouse-ftc
      revision: mouse-3.2
      import: app/west.yml
  self:
    path: config
```
